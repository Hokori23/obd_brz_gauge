## main/Kconfig.projbuild
```kconfig
menu "OBD DSP Configuration"
    choice OBD_BOARD_SELECTION
        prompt "Target board"
        default OBD_BOARD_WS_175_AMOLED
        help
            Select the board support package used by this firmware build.

        config OBD_BOARD_WS_185
            bool "Waveshare ESP32-S3-Touch-LCD-1.85"

        config OBD_BOARD_WS_175_AMOLED
            bool "Waveshare ESP32-S3-Touch-AMOLED-1.75"
    endchoice

    # Waveshare ESP32-S3-Touch-LCD-1.85
    # LCD: ST77916 (360x360 QSPI)
    # Touch: CST816 (I2C)
    # IO Expander: TCA9554PWR

    config OBD_RS485_TX_GPIO
        int "RS485 TX GPIO"
        range 0 48
        default 13
        help
            UART TX pin used by the RS485 brake temperature module.
            Do not use GPIO43/44 on this board because they are typically tied to
            the onboard USB-UART bridge.

    config OBD_RS485_RX_GPIO
        int "RS485 RX GPIO"
        range 0 48
        default 12
        help
            UART RX pin used by the RS485 brake temperature module.

    config OBD_RS485_DE_RE_GPIO
        int "RS485 DE/RE GPIO (-1 disables direction control)"
        range -1 48
        default -1
        help
            Optional GPIO to control RS485 transceiver direction.
            Set HIGH when transmitting and LOW when receiving.
            Keep -1 if your USB/RS485 module handles direction automatically.

    config OBD_BOOT_PRINT_ERROR_LOG
        bool "Print stored error log during boot"
        default y
        help
            When enabled, dump the persisted diagnostic error-log ring buffer
            during startup after NVS initialization. This prints up to the
            latest 20 stored error entries in chronological order.

    config OBD_BOOTSTRAP_DISPLAY_ONLY
        bool "Display-only bootstrap"
        default n
        help
            When enabled, boot only through storage/profile setup and board
            display initialization. LVGL task creation, UI startup, BLE OBD,
            and other runtime services are skipped. Use this to isolate
            early display bring-up and panel/SPI crashes.
endmenu
```

## sdkconfig.defaults.ws175
```kconfig
CONFIG_OBD_BOARD_WS_175_AMOLED=y
CONFIG_ESPTOOLPY_FLASHMODE_QIO=y
CONFIG_LV_ATTRIBUTE_FAST_MEM_USE_IRAM=y
CONFIG_LV_DISP_DEF_REFR_PERIOD=10
```
